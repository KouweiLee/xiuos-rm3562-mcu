## Ubiquitous/XiZi_IIoT_Macro/board/gd32f415rgo6/.defconfig
```kconfig
#
# XiZi_IIoT Project Default Configuration
#
CONFIG_BOARD_GD32F415RG=y
CONFIG_ARCH_ARM=y

#
# gd32f415rgo6 feature
#
# CONFIG_BSP_USING_UART is not set

#
# config default board resources
#

#
# config board app name
#
CONFIG_BOARD_APP_NAME="/XiUOS_gd32f415rgo6_app.bin"

#
# config board service table
#
CONFIG_SERVICE_TABLE_ADDRESS=0x20000000

#
# Hardware feature
#
CONFIG_RESOURCES_SERIAL=y
# CONFIG_SERIAL_USING_DMA is not set
CONFIG_SERIAL_RB_BUFSZ=128

#
# Kernel feature
#

#
# separate compile(choose none for compile once)
#
# CONFIG_SEPARATE_COMPILE is not set
# CONFIG_COMPILER_APP is not set
# CONFIG_APP_STARTUP_FROM_SDCARD is not set
CONFIG_APP_STARTUP_FROM_FLASH=y
# CONFIG_COMPILER_KERNEL is not set

#
# Memory Management
#
# CONFIG_KERNEL_MEMBLOCK is not set
CONFIG_MEM_ALIGN_SIZE=8
# CONFIG_MEM_EXTERN_SRAM is not set
CONFIG_MM_PAGE_SIZE=4096

#
# Using small memory allocator
#
CONFIG_KERNEL_SMALL_MEM_ALLOC=y
CONFIG_SMALL_NUMBER_32B=64
CONFIG_SMALL_NUMBER_64B=32

#
# Task feature
#
CONFIG_USER_APPLICATION=y
# CONFIG_TASK_ISOLATION is not set
# CONFIG_KERNEL_CAPABILITY is not set

#
# Inter-Task communication
#
CONFIG_KERNEL_SEMAPHORE=y
CONFIG_KERNEL_MUTEX=y
CONFIG_KERNEL_EVENT=y
CONFIG_KERNEL_MESSAGEQUEUE=y
CONFIG_KERNEL_SOFTTIMER=y
CONFIG_SCHED_POLICY_RR_REMAINSLICE=y
# CONFIG_SCHED_POLICY_RR is not set
# CONFIG_SCHED_POLICY_FIFO is not set
# CONFIG_KTASK_PRIORITY_8 is not set
CONFIG_KTASK_PRIORITY_32=y
# CONFIG_KTASK_PRIORITY_256 is not set
CONFIG_KTASK_PRIORITY_MAX=32
CONFIG_TICK_PER_SECOND=100
CONFIG_KERNEL_STACK_OVERFLOW_CHECK=y
CONFIG_IDLE_KTASK_STACKSIZE=1024
CONFIG_ZOMBIE_KTASK_STACKSIZE=2048

#
# Kernel Console
#
# CONFIG_KERNEL_CONSOLE is not set

#
# Kernel Hook
#
# CONFIG_KERNEL_HOOK is not set

#
# Command shell
#
# CONFIG_TOOL_SHELL is not set

#
# Kernel data structure Manage
#
CONFIG_KERNEL_QUEUEMANAGE=y
CONFIG_KERNEL_WORKQUEUE=y
CONFIG_WORKQUEUE_KTASK_STACKSIZE=2048
CONFIG_WORKQUEUE_KTASK_PRIORITY=23
CONFIG_QUEUE_MAX=16
CONFIG_KERNEL_WAITQUEUE=y
CONFIG_KERNEL_DATAQUEUE=y
# CONFIG_KERNEL_CIRCULAR_AREA is not set
# CONFIG_KERNEL_AVL_TREE is not set

#
# Kernel components init
#
CONFIG_KERNEL_COMPONENTS_INIT=y
CONFIG_ENV_INIT_KTASK_STACK_SIZE=8192
CONFIG_KERNEL_USER_MAIN=y
CONFIG_NAME_NUM_MAX=32
# CONFIG_KERNEL_DEBUG is not set
# CONFIG_ARCH_SMP is not set

#
# hash table config
#
CONFIG_ID_HTABLE_SIZE=16
CONFIG_ID_NUM_MAX=128
# CONFIG_KERNEL_TEST is not set

#
# Kernel Lib
#
CONFIG_LIB=y
CONFIG_LIB_POSIX=y
CONFIG_LIB_NEWLIB=y
# CONFIG_LIB_MUSLLIB is not set
# CONFIG_LIB_OTHER is not set

#
# C++ features
#
# CONFIG_LIB_CPLUSPLUS is not set

#
# File system
#
CONFIG_FS_VFS=y
CONFIG_VFS_USING_WORKDIR=y
CONFIG_FS_VFS_DEVFS=y
CONFIG_FS_VFS_FATFS=y
# CONFIG_FS_CH376 is not set
# CONFIG_FS_LWEXT4 is not set

#
# Tool feature
#

#
# OTA function
#
# CONFIG_TOOL_USING_OTA is not set

#
# APP_Framework
#

#
# Framework
#
CONFIG_TRANSFORM_LAYER_ATTRIUBUTE=y
CONFIG_ADD_XIZI_FEATURES=y
# CONFIG_ADD_NUTTX_FEATURES is not set
# CONFIG_ADD_RTTHREAD_FEATURES is not set
# CONFIG_SUPPORT_SENSOR_FRAMEWORK is not set
# CONFIG_SUPPORT_CONNECTION_FRAMEWORK is not set
# CONFIG_SUPPORT_KNOWING_FRAMEWORK is not set
# CONFIG_SUPPORT_CONTROL_FRAMEWORK is not set

#
# Security
#
# CONFIG_CRYPTO is not set
# CONFIG_MBEDTLS is not set

#
# Applications
#

#
# config stack size and priority of main task
#
CONFIG_MAIN_KTASK_STACK_SIZE=1024
CONFIG_MAIN_KTASK_PRIORITY=16

#
# test app
#
# CONFIG_USER_TEST is not set

#
# connection app
#
# CONFIG_APPLICATION_CONNECTION is not set

#
# control app
#

#
# knowing app
#
# CONFIG_APPLICATION_KNOWING is not set

#
# sensor app
#
# CONFIG_APPLICATION_SENSOR is not set
# CONFIG_USING_EMBEDDED_DATABASE_APP is not set
# CONFIG_APP_USING_WEBNET is not set
# CONFIG_APPLICATION_WEBSERVER is not set

#
# app lib
#
CONFIG_APP_SELECT_NEWLIB=y
# CONFIG_APP_SELECT_OTHER_LIB is not set

#
# lib using cJSON
#
# CONFIG_LIB_USING_CJSON is not set

#
# lib using queue
#
# CONFIG_LIB_USING_QUEUE is not set

#
# lib using LVGL
#
# CONFIG_LIB_LV is not set

#
# lvgl image display parameter settings
#
CONFIG_LVGL_WIDTH=320
CONFIG_LVGL_HEIGHT=320

#
# lib using embedded_database
#
# CONFIG_USING_EMBEDDED_DATABASE is not set

#
# lib using LoRaWan
#
# CONFIG_LIB_USING_LORAWAN is not set

#
# lib using MQTT
#
# CONFIG_LIB_USING_MQTT is not set

#
# lib using JerryScript
#
# CONFIG_LIB_USING_JERRYSCRIPT is not set

#
# lib using SQLite
#
# CONFIG_LIB_USING_SQLITE is not set
```

## Ubiquitous/XiZi_IIoT_Macro/board/gd32f415rgo6/third_party_driver/uart/Kconfig
```kconfig
menuconfig BSP_USING_UART5
    bool "Enable UART5"
    default n
    if BSP_USING_UART5
        config SERIAL_BUS_NAME_5
            string "serial bus 5 name"
            default "uart5"
        config SERIAL_DRV_NAME_5
            string "serial bus 5 driver name"
            default "uart5_drv"
        config SERIAL_5_DEVICE_NAME_0
                string "serial bus 5 device 0 name"
                default "uart5_dev5"   
    endif
```

## Ubiquitous/XiZi_IIoT_Macro/board/rk3562-mcu/image/amp.its
```
/*
 * Copyright (C) 2023 Rockchip Electronics Co., Ltd
 *
 * SPDX-License-Identifier: GPL-2.0
 */

/dts-v1/;
/ {
	description = "Rockchip AMP FIT Image";
	#address-cells = <1>;

	images {
		mcu {
			description  = "mcu";
			data         = /incbin/("/home/lgw/study/xiuos_dev/xiuos-rm3562-mcu/Ubiquitous/XiZi_IIoT_Macro/build/XiZi-rk3562-mcu.bin");
			type         = "standalone";	// must be "standalone"
			compression  = "none";
			arch         = "arm";		// "arm64" or "arm", the same as U-Boot state
			load         = <0x07b00000>;
			udelay       = <1000000>;
			hash {
				algo = "sha256";
			};
		};
	};

	configurations {
		default = "conf";
		conf {
			description = "Rockchip AMP images";
			rollback-index = <0x0>;
			loadables = "mcu";

			signature {
				algo = "sha256,rsa2048";
				padding = "pss";
				key-name-hint = "dev";
				sign-images = "loadables";
			};
		};
	};
};
```

## Ubiquitous/XiZi_IIoT_Macro/board/rt1062xb/third_party_driver/uart/Kconfig
```kconfig
menuconfig BSP_USING_UART1
    bool "Enable USART1"
    default y
    if BSP_USING_UART1
        config SERIAL_BUS_NAME_1
            string "serial bus 1 name"
            default "usart1"
        config SERIAL_DRV_NAME_1
            string "serial bus 1 driver name"
            default "usart1_drv"
        config SERIAL_1_DEVICE_NAME_0
            string "serial bus 1 device 0 name"
            default "usart1_dev1"   
    endif
```

## Ubiquitous/XiZi_IIoT_Macro/board/rzg2ul-m33/Kconfig
```kconfig
mainmenu "XiZi_IIoT Project Configuration"

config BSP_DIR
    string
    option env="BSP_ROOT"
    default "."

config KERNEL_DIR
    string
    option env="KERNEL_ROOT"
    default "../.."

config BOARD_RZG2UL_M33
    bool
    select  ARCH_ARM
    default y

source "$KERNEL_DIR/arch/Kconfig"

menu "rzg2ul m33 feature"
    menu "config default board resources"
        menu "config board app name"
            config BOARD_APP_NAME
                string "config board app name"
                default "/XiUOS_rzg2ul_m33_app.bin"
        endmenu

        menu "config board service table"
            config SERVICE_TABLE_ADDRESS
                hex "board service table address"
                default 0x20000000
        endmenu

    endmenu

endmenu


menu "Hardware feature"
source "$KERNEL_DIR/resources/Kconfig"
endmenu

source "$KERNEL_DIR/Kconfig"
```
