## APP_Framework/lib/pikapython/Kconfig
```kconfig
menu "lib using PikaPython"
    menuconfig LIB_USING_PIKAPYTHON
        bool "Enable support PikaPython."
        default n
        
    if LIB_USING_PIKAPYTHON
        # PikaPython configuration options
        # Note: PikaPython uses its own internal configuration system
    endif
endmenu
```

## Ubiquitous/XiZi_IIoT_Macro/board/at32f437vmt7/Kconfig
```kconfig
mainmenu "XiZi_IIoT Project Configuration"

config BSP_DIR
    string
    option env="BSP_ROOT"
    default "."

config KERNEL_DIR
    string
    option env="KERNEL_ROOT"
    default "../.."

config BOARD_AT32F437VMT7
    bool
    select  ARCH_ARM
    default y

source "$KERNEL_DIR/arch/Kconfig"

menu "at32f437vmt7 feature"
    source "$BSP_DIR/third_party_driver/Kconfig"
endmenu


menu "Hardware feature"
source "$KERNEL_DIR/resources/Kconfig"
endmenu

source "$KERNEL_DIR/Kconfig"
```

## Ubiquitous/XiZi_IIoT_Macro/board/at32f437vmt7/third_party_driver/Kconfig
```kconfig
menu "common config"
source "$BSP_DIR/third_party_driver/common/Kconfig"
endmenu

menuconfig BSP_USING_UART
    bool "Using UART device"
    default y
    select RESOURCES_SERIAL
    if BSP_USING_UART
        source "$BSP_DIR/third_party_driver/uart/Kconfig"
    endif

menuconfig BSP_USING_ETH
    bool "Using ethernet device"
    default y
    if BSP_USING_ETH
        source "$BSP_DIR/third_party_driver/ethernet/Kconfig"
    endif
```

## Ubiquitous/XiZi_IIoT_Macro/board/at32f437vmt7/third_party_driver/common/Kconfig
```kconfig
choice
    prompt "Config the value of high speed external crystal (hext)"
    default HEXT_VALUE_24MHZ

    config HEXT_VALUE_8MHZ
        bool "8MHZ"

    config HEXT_VALUE_24MHZ
        bool "24MHZ"
endchoice
```

## Ubiquitous/XiZi_IIoT_Macro/board/at32f437vmt7/third_party_driver/ethernet/Kconfig
```kconfig
config BSP_USING_YT8512
    bool "Using Ethernet PHY YT8512"
    default y
    select RESOURCES_LWIP

config BSP_USING_LWIP
    bool "Using LWIP"
    default y
    select RESOURCES_LWIP
```

## Ubiquitous/XiZi_IIoT_Macro/board/at32f437vmt7/third_party_driver/uart/Kconfig
```kconfig
menuconfig BSP_USING_UART1
    bool "Enable USART1 for Console"
    default y
    if BSP_USING_UART1
        config SERIAL_BUS_NAME_1
            string "serial bus 1 name"
            default "usart1"
        config SERIAL_DRV_NAME_1
            string "serial bus 1 driver name"
            default "usart1_drv"
        config SERIAL_1_DEVICE_NAME_0
            string "serial bus 1 device 0 name"
            default "usart1_dev1"
    endif

menuconfig BSP_USING_UART2
    bool "Enable USART2 for RS485/RS322"
    default y
    if BSP_USING_UART2
        config SERIAL_BUS_NAME_2
            string "serial bus 2 name"
            default "usart2"
        config SERIAL_DRV_NAME_2
            string "serial bus 2 driver name"
            default "usart2_drv"
        config SERIAL_2_DEVICE_NAME_0
            string "serial bus 2 device 0 name"
            default "usart2_dev2"
    endif

menuconfig BSP_USING_CONSOLE
    bool "Enable Console"
    default y
    select BSP_USING_UART1
    select KERNEL_CONSOLE
    if BSP_USING_CONSOLE
        config KERNEL_CONSOLE_BUS_NAME
            string "Console bus name"
            default "usart1"
        config KERNEL_CONSOLE_DRV_NAME
            string "Console bus driver name"
            default "usart1_drv"
        config KERNEL_CONSOLE_DEVICE_NAME
            string "Console bus device name"
            default "usart1_dev1"
    endif

config BSP_USING_RS485
    bool "Enable RS485"
    default y
    select BSP_USING_UART2

config BSP_USING_RS232
    bool "Enable RS232"
    default y
    select BSP_USING_UART2
```

## Ubiquitous/XiZi_IIoT_Macro/board/ch32v208rbt6/third_party_driver/Kconfig
```kconfig
menuconfig BSP_USING_UART
    bool "Using UART device"
    default y
    select RESOURCES_SERIAL
    if BSP_USING_UART
        source "$BSP_DIR/third_party_driver/uart/Kconfig"
    endif
    
menuconfig BSP_USING_ETH
    bool "Using Ethernet"
    default y

menuconfig BSP_USING_ADC
    bool "Using ADC"
    default y

menuconfig BSP_USING_BLE
    bool "Using BLE"
    default y
	if BSP_USING_BLE
		config BSP_BLE_CONFIG
			bool "Using BLE config"
    		default y
			help
				Enable this option to use BLE (Bluetooth Low Energy) to configure settings.
				note: prerequisite: [KConfig - ch32v208rbt6 feature] must enable BLE, ETH, LTE, and RS485 modules.
			if BSP_BLE_CONFIG
				config DEV_BLE_NAME
					string "device ble name"
					default "ch32v208rbt6"
				config DEV_INFO_SYSTEM_ID_0
    				int "Device Info System ID Element 0"
    				default 0
				config DEV_INFO_SYSTEM_ID_1
					int "Device Info System ID Element 1"
					default 0
				config DEV_INFO_SYSTEM_ID_2
					int "Device Info System ID Element 2"
					default 0
				config DEV_INFO_SYSTEM_ID_3
					int "Device Info System ID Element 3"
					default 0
				config DEV_INFO_SYSTEM_ID_4
					int "Device Info System ID Element 4"
					default 0
				config DEV_INFO_SYSTEM_ID_5
					int "Device Info System ID Element 5"
					default 1
				config DEV_INFO_SYSTEM_ID_6
					int "Device Info System ID Element 6"
					default 127
				config DEV_INFO_SYSTEM_ID_7
					int "Device Info System ID Element 7"
					default 1
				config DEV_INFO_MODEL_NUMBER
					string "dev info model number"
					default "Model Number"
				config DEV_INFO_SERIAL_NUMBER
					string "dev info serial number"
					default "Serial Number"
				config DEV_INFO_FIRMWARE_REV
					string "dev info firmware revision"
					default "Firmware Revision"
				config DEV_INFO_HARDWARE_REV
					string "dev info hardware revision"
					default "Hardware Revision"
				config DEV_INFO_SOFTWARE_REV
					string "dev info software revision"
					default "Software Revision"
				config DEV_INFO_MANUFACTURER_NAME
					string "dev info manufacturer name"
					default "Manufacturer Name"
			endif
	endif

menuconfig BSP_USING_CAN
    bool "Using CAN device"
    default y
    select RESOURCES_CAN
    if BSP_USING_CAN
        source "$BSP_DIR/third_party_driver/can/Kconfig"
    endif
    
menuconfig BSP_USING_RS485
	bool "Using RS485"
	default y
	if BSP_USING_RS485
        config RS485_BUS_NAME
            string "rs485 bus name"
            default "rs485"
        config RS485_DRV_NAME
            string "rs485 bus driver name"
            default "rs485_drv"
        config RS485_DEVICE_NAME_1
            string "rs485 bus device 1 name"
            default "rs485_dev1"
	endif

menuconfig BSP_USING_LTE
	bool "Using LTE"
	default y
   	if BSP_USING_LTE
    	config LTE_BUS_NAME
            string "lte bus name"
            default "lte"
        config LTE_DRV_NAME
            string "lte bus driver name"
            default "lte_drv"
        config LTE_DEVICE_NAME_1
            string "lte bus device 1 name"
            default "lte_dev1"
        config LTE_TEST
            bool "Enable lte test"
            default n
    endif	
	
```

## Ubiquitous/XiZi_IIoT_Macro/board/ch32v208rbt6/third_party_driver/can/Kconfig
```kconfig
config CAN_BUS_NAME
    string "can bus name"
    default "can"

config CAN_DRIVER_NAME
    string "can bus driver name"
    default "can_drv"

config CAN_DEVICE_NAME_1
    string "can bus device 1 name"
    default "can_dev1"
```

## Ubiquitous/XiZi_IIoT_Macro/board/ch32v208rbt6/third_party_driver/lte/Kconfig
```kconfig
menuconfig BSP_USING_LTE
    bool "Enable LTE"
    default y
    if BSP_USING_LTE
        config LTE_BUS_NAME
            string "lte bus name"
            default "lte"
        config LTE_DRV_NAME
            string "lte bus driver name"
            default "lte_drv"
        config LTE_DEVICE_NAME_1
                string "lte bus device 1 name"
                default "lte_dev1"
    endif
```

## Ubiquitous/XiZi_IIoT_Macro/board/ch32v307vct6/third_party_driver/Kconfig
```kconfig
menuconfig BSP_USING_UART
    bool "Using UART device"
    default y
    select RESOURCES_SERIAL
    if BSP_USING_UART
        source "$BSP_DIR/third_party_driver/uart/Kconfig"
    endif

menuconfig BSP_USING_GPIO
    bool "Using GPIO"
    default y
    select RESOURCES_SERIAL
    if BSP_USING_GPIO
        source "$BSP_DIR/third_party_driver/gpio/Kconfig"
    endif

menuconfig BSP_USING_ETH
    bool "Using Ethernet"
    default y
 
menuconfig BSP_USING_CAN
    bool "Using CAN device"
    default y
    select RESOURCES_CAN
    if BSP_USING_CAN
        source "$BSP_DIR/third_party_driver/can/Kconfig"
    endif


menuconfig BSP_USING_USB
    bool "Using USB device"
    default y
    select BSP_USING_USBH
    select RESOURCES_USB
    select RESOURCES_USB_HOST
    select USBH_MSTORAGE
    select RESOURCES_USB_DEVICE
    if BSP_USING_USB
        source "$BSP_DIR/third_party_driver/usb/Kconfig"
    endif
```

## Ubiquitous/XiZi_IIoT_Macro/board/ch32v307vct6/third_party_driver/uart/Kconfig
```kconfig
menuconfig BSP_USING_UART1
    bool "Enable UART1"
    default n
    if BSP_USING_UART1
        config SERIAL_BUS_NAME_1
            string "serial bus  name"
            default "uart1"
        config SERIAL_DRV_NAME_1
            string "serial bus  driver name"
            default "uart1_drv"
        config SERIAL_1_DEVICE_NAME_0
                string "serial bus  device name"
                default "uart1_dev1"   
    endif

menuconfig BSP_USING_UART2
    bool "Enable UART2"
    default n
    if BSP_USING_UART2
        config SERIAL_BUS_NAME_2
            string "serial bus  name"
            default "uart2"
        config SERIAL_DRV_NAME_2
            string "serial bus  driver name"
            default "uart2_drv"
        config SERIAL_2_DEVICE_NAME_0
                string "serial bus  device name"
                default "uart2_dev2"   
    endif

menuconfig BSP_USING_UART4
    bool "Enable UART4"
    default y
    if BSP_USING_UART4
        config SERIAL_BUS_NAME_4
            string "serial bus  name"
            default "uart4"
        config SERIAL_DRV_NAME_4
            string "serial bus  driver name"
            default "uart4_drv"
        config SERIAL_4_DEVICE_NAME_0
                string "serial bus  device name"
                default "uart4_dev4"   
    endif

menuconfig BSP_USING_UART5
    bool "Enable UART5"
    default y
    if BSP_USING_UART5
        config SERIAL_BUS_NAME_5
            string "serial bus name"
            default "uart5"
        config SERIAL_DRV_NAME_5
            string "serial bus  driver name"
            default "uart5_drv"
        config SERIAL_5_DEVICE_NAME_0
                string "serial bus  device name"
                default "uart5_dev5"   
    endif
```

## Ubiquitous/XiZi_IIoT_Macro/board/ch569w/third_party_driver/Kconfig
```kconfig
menuconfig BSP_USING_UART
    bool "Using UART device"
    default y
    select RESOURCES_SERIAL
    if BSP_USING_UART
        source "$BSP_DIR/third_party_driver/uart/Kconfig"
    endif

menuconfig BSP_USING_SPI
    bool "Using SPI device"
    default y
    if BSP_USING_SPI
        source "$BSP_DIR/third_party_driver/spi/Kconfig"
    endif

menuconfig BSP_USING_SERDES
    bool "Using serdes device"
    default y
    if BSP_USING_SERDES
        source "$BSP_DIR/third_party_driver/serdes/Kconfig"
    endif

menuconfig BSP_USING_USB
    bool "Using usb device"
    default y
    if BSP_USING_USB
        source "$BSP_DIR/third_party_driver/usb/Kconfig"
    endif

menuconfig BSP_USING_WDT
    bool "Using watchdog timer device"
    default n
```

## Ubiquitous/XiZi_IIoT_Macro/board/ch569w/third_party_driver/serdes/Kconfig
```kconfig
config SERDES_TRANS
        bool "Config serdes transmit mode."
        default y

config SERIAL_RECEI
        bool "Config serdes receive mode."
        default y
```

## Ubiquitous/XiZi_IIoT_Macro/board/ch569w/third_party_driver/usb/Kconfig
```kconfig
menuconfig BSP_USING_USBD
    bool "Using usbd device"
    default y
    if BSP_USING_USBD
        source "$BSP_DIR/third_party_driver/usb/usbd/Kconfig"
    endif
```

## Ubiquitous/XiZi_IIoT_Macro/board/cortex-m7-emulator/Kconfig
```kconfig
mainmenu "XiZi_IIoT Project Configuration"

config BSP_DIR
    string
    option env="BSP_ROOT"
    default "."

config KERNEL_DIR
    string
    option env="KERNEL_ROOT"
    default "../.."

config BOARD_CORTEX_V2M_EVB
    bool
    select  ARCH_ARM
    default y


source "$KERNEL_DIR/arch/Kconfig"

menu "cortex-m7-emulator feature"
    source "$BSP_DIR/third_party_driver/Kconfig"
    
    menu "config default board resources"
        menu "config board app name"
            config BOARD_APP_NAME
                string "config board app name"
                default "/XiUOS_cortex-m7-emulator_app.bin"
        endmenu

        menu "config board service table"
            config SERVICE_TABLE_ADDRESS
                hex "board service table address"
                default 0x20000000
        endmenu

        
    endmenu

    config __STACKSIZE__
        int "stack size for interrupt"
        default 4096

    menu "config board peripheral"
        config MOUNT_SDCARD
            bool
            default n
        config MOUNT_USB
            bool
            default n
    endmenu


endmenu


menu "Hardware feature"
source "$KERNEL_DIR/resources/Kconfig"
endmenu

source "$KERNEL_DIR/Kconfig"
```

## Ubiquitous/XiZi_IIoT_Macro/board/edu-arm32/third_party_driver/adc/Kconfig
```kconfig
if BSP_USING_ADC
    config ADC1_BUS_NAME
        string "adc 1 bus name"
        default "adc1"

    config ADC1_DRIVER_NAME
        string "adc 1 driver name"
        default "adc1_drv"

    config ADC1_DEVICE_NAME
        string "adc 1 bus device name"
        default "adc1_dev"
endif
```

## Ubiquitous/XiZi_IIoT_Macro/board/edu-riscv64/third_party_driver/ethernet/Kconfig
```kconfig
# Kconfig file

config BSP_USING_W5500
    bool "Using w5500"
    select BSP_USING_LWIP
    default y

config BSP_WIZ_RST_PIN
    int 
    default 13

config BSP_WIZ_INT_PIN
    int 
    default 14

config BSP_WIZ_USE_IPERF
    bool "Using iperf"
    default y

menuconfig BSP_USING_LWIP
    bool "Using LwIP device"
    default n
    select RESOURCES_LWIP
```

## Ubiquitous/XiZi_IIoT_Macro/board/edu-riscv64/third_party_driver/timer/Kconfig
```kconfig
if BSP_USING_HWTIMER
    config HWTIMER_BUS_NAME_1
    string "hwtimer bus name"
    default "timer0"

    menuconfig ENABLE_TIM1
    bool "enable TIM1"
    default y

    if ENABLE_TIM1
        config HWTIMER_1_DEVICE_NAME_1
        string "TIM1 dev name"
        default "timer0_dev0"

        config HWTIMER_DRIVER_NAME_1
        string "TIM1 drv name"
        default "timer0_drv"
    endif
endif
```
