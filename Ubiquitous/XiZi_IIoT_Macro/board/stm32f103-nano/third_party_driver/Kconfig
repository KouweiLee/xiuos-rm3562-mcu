## Ubiquitous/XiZi_IIoT_Macro/board/stm32f103-nano/third_party_driver/Kconfig
```kconfig
menuconfig BSP_USING_UART
bool "Using UART device"
default y
select RESOURCES_SERIAL
if BSP_USING_UART
source "$BSP_DIR/third_party_driver/uart/Kconfig"
endif


menuconfig BSP_USING_CAN
bool "Using CAN device"
default y
select RESOURCES_CAN
if BSP_USING_CAN
source "$BSP_DIR/third_party_driver/can/Kconfig"
endif
```

## Ubiquitous/XiZi_IIoT_Macro/board/stm32f103-nano/third_party_driver/common/Kconfig
```kconfig
menuconfig BSP_USING_YMODEM
    bool "Enable ymodem"
    default y
    if BSP_USING_YMODEM
        config YMODEM_BUS_NAME
            string "serial bus 1 name"
            default "uart1"
        config YMODEM_DRV_NAME
            string "serial bus 1 driver name"
            default "uart1_drv"
        config YMODEM_DEVICE_NAME
                string "serial bus 1 device name"
                default "uart1_dev1"   
    endif
```

## Ubiquitous/XiZi_IIoT_Macro/board/stm32g474/third_party_driver/Kconfig
```kconfig
menuconfig BSP_USING_USB
    bool "Enable USB Device"
    default y

if BSP_USING_USB
    source "$BSP_DIR/third_party_driver/usb/Kconfig"
endif

menuconfig BSP_USING_UART
    bool "Enable UART Device"
    default y

if BSP_USING_UART
    source "$BSP_DIR/third_party_driver/uart/Kconfig"
endif

menuconfig BSP_USING_CAN
    bool "Enable CAN Device"
    default y

if BSP_USING_CAN
    source "$BSP_DIR/third_party_driver/can/Kconfig"
endif

menuconfig BSP_USING_SPI
    bool "Enable SPI Device"
    default y

if BSP_USING_SPI
    source "$BSP_DIR/third_party_driver/spi/Kconfig"
endif
```

## Ubiquitous/XiZi_IIoT_Macro/board/stm32g474/third_party_driver/can/Kconfig
```kconfig
menuconfig BSP_USING_CAN1
    bool "Enable CAN1"
    default y

if BSP_USING_CAN1
    config CAN1_BUS_NAME
        string "can1 bus name"
        default "can1"
    config CAN1_DRV_NAME
        string "can1 bus driver name"
        default "can1_drv"
    config CAN1_DEVICE_NAME
        string "can1 bus device name"
        default "can1_dev"   
endif

menuconfig BSP_USING_CAN2
    bool "Enable CAN2"
    default y

if BSP_USING_CAN2
    config CAN2_BUS_NAME
        string "can2 bus name"
        default "can2"
    config CAN2_DRV_NAME
        string "can2 bus driver name"
        default "can2_drv"
    config CAN2_DEVICE_NAME
        string "can2 bus device name"
        default "can2_dev"   
endif

menuconfig BSP_USING_CAN3
    bool "Enable CAN3"
    default y

if BSP_USING_CAN3
    config CAN3_BUS_NAME
        string "can3 bus name"
        default "can3"
    config CAN3_DRV_NAME
        string "can3 bus driver name"
        default "can3_drv"
    config CAN3_DEVICE_NAME
        string "can3 bus device name"
        default "can3_dev"   
endif
```

## Ubiquitous/XiZi_IIoT_Macro/board/stm32g474/third_party_driver/spi/Kconfig
```kconfig
menuconfig BSP_USING_SPI1
    bool "Enable SPI1"
    default y

if BSP_USING_SPI1
    config SPI1_BUS_NAME
        string "spi1 bus name"
        default "spi1"
    config SPI1_DRV_NAME
        string "spi 1 bus driver name"
        default "spi1_drv"
    config SPI1_DEVICE_NAME
        string "spi1 bus device name"
        default "spi1_dev"   
endif
```

## Ubiquitous/XiZi_IIoT_Macro/board/stm32g474/third_party_driver/uart/Kconfig
```kconfig
menuconfig BSP_USING_UART1
    bool "Enable UART1"
    default y

if BSP_USING_UART1
    config SERIAL1_BUS_NAME
        string "serial1 bus name"
        default "uart1"
    config SERIAL1_DRV_NAME
        string "serial 1 bus driver name"
        default "uart1_drv"
    config SERIAL1_DEVICE_NAME
        string "serial 1 bus device name"
        default "uart1_dev"   
endif
```

## Ubiquitous/XiZi_IIoT_Macro/board/stm32g474/third_party_driver/usb/Kconfig
```kconfig
menu "USB Configuration"

config USB_BUS_NAME
    string "USB Bus Name"
    default "usb"

config USB_DRIVER_NAME
    string "USB Driver Name"
    default "usb_drv"

config USB_DEVICE_NAME
    string "USB Device Name"
    default "usb_dev"

endmenu
```

## Ubiquitous/XiZi_IIoT_Macro/board/stm32l476rgt6/third_party_driver/Kconfig
```kconfig
menuconfig BSP_USING_UART
    bool "Using UART device"
    default y
    select RESOURCES_SERIAL
    if BSP_USING_UART
        source "$BSP_DIR/third_party_driver/uart/Kconfig"
    endif


menuconfig BSP_USING_SPI
    bool "Using SPI device"
    default n
    select RESOURCES_SPI
    if BSP_USING_SPI
        source "$BSP_DIR/third_party_driver/spi/Kconfig"
    endif

menuconfig BSP_USING_USB
    bool "Using USB device"
    default n
    select RESOURCES_USB
    if BSP_USING_USB
        source "$BSP_DIR/third_party_driver/usb/Kconfig"
    endif

menuconfig BSP_USING_WDT
    bool "Using WDT device"
    default n
    select RESOURCES_WDT
    if BSP_USING_WDT
        source "$BSP_DIR/third_party_driver/watchdog/Kconfig"
    endif

menuconfig BSP_USING_CAN
    bool "Using CAN device"
    default n
    select RESOURCES_CAN
    if BSP_USING_CAN
        source "$BSP_DIR/third_party_driver/can/Kconfig"
    endif
```

## Ubiquitous/XiZi_IIoT_Macro/board/stm32l476rgt6/third_party_driver/can/Kconfig
```kconfig
config CAN_BUS_NAME
    string "can bus name"
    default "can1"

config CAN_DRIVER_NAME
    string "can driver name"
    default "can1_drv"

config CAN_DEVICE_NAME
    string "can device name"
    default "can1_dev1"
```

## Ubiquitous/XiZi_IIoT_Macro/board/stm32l476rgt6/third_party_driver/spi/Kconfig
```kconfig
if BSP_USING_SPI
    config BSP_USING_SPI2
    bool "Using spi2"
    default y

    if BSP_USING_SPI2
        config SPI_BUS_NAME_2
            string "spi bus 2 name"
            default "spi2"
        config SPI_2_DEVICE_NAME_0
            string "spi bus 2 device 0 name"
            default "spi2_dev0" 
        config SPI_2_DRV_NAME
            string "spi bus 2 driver name"
            default "spi2_drv"
    endif   

    config BSP_USING_SPI3
    bool "Using spi3"
    default n

    if BSP_USING_SPI3
        config SPI_BUS_NAME_3
            string "spi bus 3 name"
            default "spi3"
        config SPI_3_DEVICE_NAME_0
            string "spi bus 3 device 0 name"
            default "spi3_dev0" 
        config SPI_3_DRV_NAME
            string "spi bus 3 driver name"
            default "spi3_drv"
    endif
endif
```

## Ubiquitous/XiZi_IIoT_Macro/board/stm32l476rgt6/third_party_driver/uart/Kconfig
```kconfig
menuconfig BSP_USING_UART1
    bool "Enable USART1"
    default n
    if BSP_USING_UART1
        config SERIAL_BUS_NAME_1
            string "serial bus 1 name"
            default "usart1"
        config SERIAL_DRV_NAME_1
            string "serial bus 1 driver name"
            default "usart1_drv"
        config SERIAL_1_DEVICE_NAME_0
            string "serial bus 1 device 0 name"
            default "usart1_dev1"   
    endif
menuconfig BSP_USING_UART2
    bool "Enable USART2"
    default y
    if BSP_USING_UART2
        config SERIAL_BUS_NAME_2
            string "serial bus 2 name"
            default "usart2"
        config SERIAL_DRV_NAME_2
            string "serial bus 2 driver name"
            default "usart2_drv"
        config SERIAL_2_DEVICE_NAME_0
            string "serial bus 2 device 0 name"
            default "usart2_dev2"   
    endif
menuconfig BSP_USING_UART3
    bool "Enable USART3"
    default y
    if BSP_USING_UART3
        config SERIAL_BUS_NAME_3
            string "serial bus 3 name"
            default "usart3"
        config SERIAL_DRV_NAME_3
            string "serial bus 3 driver name"
            default "usart3_drv"
        config SERIAL_3_DEVICE_NAME_0
            string "serial bus 3 device 0 name"
            default "usart3_dev3"   
    endif

menuconfig BSP_USING_UART4
    bool "Enable UART4 for RS485"
    default n
    select BSP_USING_RS485
    if BSP_USING_UART4
        config SERIAL_BUS_NAME_4
            string "serial bus 4 name"
            default "usart4"
        config SERIAL_DRV_NAME_4
            string "serial bus 4 driver name"
            default "usart4_drv"
        config SERIAL_4_DEVICE_NAME_0
            string "serial bus 4 device 0 name"
            default "usart4_dev4"   
    endif

config BSP_USING_RS485
    bool
    default n

menuconfig BSP_USING_UART5
    bool "Enable USART5"
    default n
    if BSP_USING_UART5
        config SERIAL_BUS_NAME_5
            string "serial bus 5 name"
            default "usart5"
        config SERIAL_DRV_NAME_5
            string "serial bus 5 driver name"
            default "usart5_drv"
        config SERIAL_5_DEVICE_NAME_0
            string "serial bus 5 device 0 name"
            default "usart5_dev5"   
    endif
```

## Ubiquitous/XiZi_IIoT_Macro/board/stm32l476rgt6/third_party_driver/usb/Kconfig
```kconfig
config BSP_USING_USB
    bool "Using usb device by HAL library"
    default y

    config USB_BUS_NAME
        string "usb bus name"
        default "usb"
    config USB_DRIVER_NAME
        string "usb bus driver name"
        default "usb_drv"
    config USB_DEVICE_NAME
        string "usb bus device name"
        default "usb_dev"
```

## Ubiquitous/XiZi_IIoT_Macro/board/xishutong-arm32/third_party_driver/Kconfig
```kconfig
menuconfig BSP_USING_ADC
    bool "Using ADC device"
    default n
    select RESOURCES_ADC
    if BSP_USING_ADC
        source "$BSP_DIR/third_party_driver/adc/Kconfig"
    endif

menuconfig BSP_USING_DAC
    bool "Using DAC device"
    default n
    select RESOURCES_DAC
    if BSP_USING_DAC
        source "$BSP_DIR/third_party_driver/dac/Kconfig"
    endif

menuconfig BSP_USING_CAN
    bool "Using CAN device"
    default n
    select RESOURCES_CAN
    if BSP_USING_CAN
        source "$BSP_DIR/third_party_driver/can/Kconfig"
    endif

menuconfig BSP_USING_UART
    bool "Using UART device"
    default y
    select RESOURCES_SERIAL
    if BSP_USING_UART
        source "$BSP_DIR/third_party_driver/usart/Kconfig"
    endif

menuconfig BSP_USING_GPIO
    bool "Using GPIO device "
    default y
    select RESOURCES_PIN
    if BSP_USING_GPIO
        source "$BSP_DIR/third_party_driver/gpio/Kconfig"
    endif

menuconfig BSP_USING_ETHERNET
    bool "Using MAC ethernet device"
    default n
    select BSP_USING_LWIP
    if BSP_USING_ETHERNET
        source "$BSP_DIR/third_party_driver/ethernet/Kconfig"
    endif

menuconfig BSP_USING_W5500
    bool "Using W5500 ethernet device"
    default n
    select BSP_USING_ETHERNET
    select BSP_USING_LWIP
    select BSP_USING_SPI
    select BSP_USING_SPI1
    if BSP_USING_W5500
        source "$BSP_DIR/third_party_driver/ethernet_wiz/Kconfig"
    endif

config BSP_USING_LWIP
    bool
    default n
    select RESOURCES_LWIP

menuconfig BSP_USING_SDIO
    bool "Using SD CARD device"
    default n
    select RESOURCES_SDIO
    if BSP_USING_SDIO
        source "$BSP_DIR/third_party_driver/sdio/Kconfig"
    endif

menuconfig BSP_USING_USB
    bool "Using USB device"
    default n
    select RESOURCES_USB
    if BSP_USING_USB
        source "$BSP_DIR/third_party_driver/usb/Kconfig"
    endif

menuconfig BSP_USING_SPI
    bool "Using SPI device"
    default n
    select RESOURCES_SPI
    if BSP_USING_SPI
        source "$BSP_DIR/third_party_driver/spi/Kconfig"
    endif

menuconfig BSP_USING_SDRAM
    bool "Using SDRAM IS42S16400J"
    default n
    if BSP_USING_SDRAM
        source "$BSP_DIR/third_party_driver/sdram/Kconfig"
    endif
```

## Ubiquitous/XiZi_IIoT_Macro/board/xishutong-arm32/third_party_driver/sdram/Kconfig
```kconfig
config BSP_USING_EXTSDRAM
    bool "config extern sdram"
    default y
    select MEM_EXTERN_SRAM
    if BSP_USING_EXTSDRAM
        config EXTSRAM_MAX_NUM
            int
            default 1
        config EXTSRAM_TEST
            bool "extern sdram write/read test"
            default n
    endif
```

## Ubiquitous/XiZi_IIoT_Macro/board/xishutong-arm32/third_party_driver/spi/Kconfig
```kconfig
if BSP_USING_SPI
    config BSP_USING_SPI1
    bool "Using spi1 for W5500"
    default y

    if BSP_USING_SPI1
        config SPI_BUS_NAME_1
            string "spi bus 1 name"
            default "spi1"
        config SPI_1_DEVICE_NAME_0
            string "spi bus 1 device 0 name"
            default "spi1_dev0" 
        config SPI_1_DRV_NAME
            string "spi bus 1 driver name"
            default "spi1_drv"
    endif   

    config BSP_USING_SPI2
    bool "Using spi2 for E22 LoRa"
    default y

    if BSP_USING_SPI2
        config SPI_BUS_NAME_2
            string "spi bus 2 name"
            default "spi2"
        config SPI_2_DEVICE_NAME_0
            string "spi bus 2 device 0 name"
            default "spi2_dev0" 
        config SPI_2_DRV_NAME
            string "spi bus 2 driver name"
            default "spi2_drv"
    endif  
endif
```

## Ubiquitous/XiZi_IIoT_Macro/board/xishutong-arm32/third_party_driver/usart/Kconfig
```kconfig
menuconfig BSP_USING_UART3
    bool "Enable USART3"
    default y
    if BSP_USING_UART3
        config SERIAL_BUS_NAME_3
            string "serial bus 3 name"
            default "usart3"
        config SERIAL_DRV_NAME_3
            string "serial bus 3 driver name"
            default "usart3_drv"
        config SERIAL_3_DEVICE_NAME_0
            string "serial bus 3 device 0 name"
            default "usart3_dev3"   
    endif

menuconfig BSP_USING_UART4
    bool "Enable USART4 for RS485"
    default y
    select BSP_USING_RS485
    if BSP_USING_UART4
        config SERIAL_BUS_NAME_4
            string "serial bus 4 name"
            default "usart4"
        config SERIAL_DRV_NAME_4
            string "serial bus 4 driver name"
            default "usart4_drv"
        config SERIAL_4_DEVICE_NAME_0
            string "serial bus 4 device 0 name"
            default "usart4_dev4" 
    endif

config BSP_USING_RS485
    bool
    default n

menuconfig BSP_USING_UART6
    bool "Enable USART6 for 4G EC200A"
    default y
    if BSP_USING_UART6
        config SERIAL_BUS_NAME_6
            string "serial bus 6 name"
            default "usart6"
        config SERIAL_DRV_NAME_6
            string "serial bus 6 driver name"
            default "usart6_drv"
        config SERIAL_6_DEVICE_NAME_0
            string "serial bus 6 device 0 name"
            default "usart6_dev6"   
    endif
```
