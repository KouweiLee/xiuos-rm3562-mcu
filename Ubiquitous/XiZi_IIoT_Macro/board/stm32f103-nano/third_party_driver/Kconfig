## Ubiquitous/XiZi_IIoT_Macro/tool/bootloader/Kconfig
```kconfig
menu "OTA function"

    menuconfig TOOL_USING_OTA
        bool "Enable support OTA function"
        default n
        
    if TOOL_USING_OTA
        choice 
            prompt "Compile bootloader bin or application bin."
            default MCUBOOT_APPLICATION

            config MCUBOOT_BOOTLOADER
                    bool "Config as bootloader."

            config MCUBOOT_APPLICATION
                    bool "Config as application."
        endchoice

        choice 
            prompt "The way of OTA firmware upgrade."
            default OTA_BY_PLATFORM

            config OTA_BY_PLATFORM
                bool "Through IoT management platform."
                select LIB_USING_MQTT

            config OTA_BY_TCPSERVER
                bool "Through the public network TCP server."
                select SUPPORT_CONNECTION_FRAMEWORK
                select CONNECTION_ADAPTER_4G

            config OTA_BY_NONE
                bool "Not download firmware."
        endchoice

        menu "Flash area address and size configuration."
            config CHIP_FLAH_BASE
                hex "Flash base address of the chip."
                default 0x60000000

            config XIUOS_FLAH_ADDRESS
                hex "Flash area address of the XiUOS system."
                default 0x60100000

            config BAKUP_FLAH_ADDRESS
                hex "Flash area address of the backup firmware."
                default 0x60300000

            config DOWN_FLAH_ADDRESS
                hex "Flash area address of the downloaded firmware."
                default 0x60500000

            config FLAG_FLAH_ADDRESS
                hex "Flash area address of the OTA information."
                default 0x60700000

            config APP_FLASH_SIZE
                hex "Application package size,the default size is limited to 1M."
                default 0x00100000
        endmenu

        config OTA_RX_TIMEOUT
            int "OTA receive data timeout(ms)."
            default 600 if OTA_BY_PLATFORM
            default 10000 if OTA_BY_TCPSERVER
            default 10000 if MCUBOOT_BOOTLOADER
        
        config OTA_FRAME_SIZE
            int "OTA receive data frame size."
            default 2048 if OTA_BY_PLATFORM
            default 1024 if OTA_BY_TCPSERVER
            default 0 if MCUBOOT_BOOTLOADER
    endif

endmenu
```
